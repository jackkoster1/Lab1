# file: lab6.ioc
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Mcu.Family=STM32F0
Mcu.Name=STM32F072R(8-B)Tx
Mcu.Package=LQFP64
ProjectManager.HeapSize=0x200
ProjectManager.StackSize=0x400
ProjectManager.TargetToolchain=MDK-ARM V5
board=custom

// file: Core/Src/main.c
/* USER CODE BEGIN Header */
/**
  ******************************************************************************
  * @file           : main.c
  * @brief          : Main program body
  ******************************************************************************
  * @attention
  *
  * Copyright (c) 2024 STMicroelectronics.
  * All rights reserved.
  *
  * This software is licensed under terms that can be found in the LICENSE file
  * in the root directory of this software component.
  * If no LICENSE file comes with this software, it is provided AS-IS.
  *
  ******************************************************************************
  */
/* USER CODE END Header */
#include "main.h"

void SystemClock_Config(void);

// Sine Wave: 8-bit, 32 samples/cycle
const uint8_t sine_table[32] = {127,151,175,197,216,232,244,251,254,251,244,
232,216,197,175,151,127,102,78,56,37,21,9,2,0,2,9,21,37,56,78,102};
// Triangle Wave: 8-bit, 32 samples/cycle
const uint8_t triangle_table[32] = {0,15,31,47,63,79,95,111,127,142,158,174,
190,206,222,238,254,238,222,206,190,174,158,142,127,111,95,79,63,47,31,15};
// Sawtooth Wave: 8-bit, 32 samples/cycle
const uint8_t sawtooth_table[32] = {0,7,15,23,31,39,47,55,63,71,79,87,95,103,
111,119,127,134,142,150,158,166,174,182,190,198,206,214,222,230,238,246};
// Square Wave: 8-bit, 32 samples/cycle
const uint8_t square_table[32] = {254,254,254,254,254,254,254,254,254,254,
254,254,254,254,254,254,0,0,0,0,0,0,0,0,0,0,0,0,0,0,0,0};
int16_t red = 6;
int16_t blue = 7;
int16_t orange = 8;
int16_t green = 9;
void init_led()
{
	RCC->AHBENR |= RCC_AHBENR_GPIOCEN;
	GPIOC->MODER &= ~((1<<(red*2+1))|(1<<(green*2+1)) | (1<<(blue*2+1))|(1<<(orange*2+1)));
	GPIOC->MODER |= (1<<red*2)|(1<<green*2) | (1<<blue*2)|(1<<orange*2);
	GPIOC->OTYPER &= ~((1<<red) | (1<<green) | (1<<blue) | (1<<orange));
	GPIOC->OSPEEDR &= ~((1<<red*2) | (1<<green*2) | (1<<blue*2) | (1<<orange*2));
	GPIOC->PUPDR &= ~((1<<green*2) | (1<<(red*2+1)) |(1<<red*2)|(1<<(green*2+1)) |( 1<<blue*2) | (1<<(orange*2+1)) |(1<<orange*2)|(1<<(blue*2+1)) );
}
void init_analog()
{
	//ADC
	RCC->AHBENR |= RCC_AHBENR_GPIOCEN;
	GPIOC->MODER |= //pc0 to analog
	GPIOC->PUPDR &= ~3; //no pull up/down
	//DAC
	RCC->AHBENR |= RCC_AHBENR_GPIOAEN;
	GPIOA->MODER |= 3 << 8; //pa4 to analog
	GPIOC->PUPDR &= ~3; //no pull up/down
}
int main(void)
{
	init_led();

	init_analog();

	RCC->APB2ENR |= RCC_APB2ENR_ADC1EN;
	RCC->APB1ENR |= RCC_APB1ENR_DACEN;
	ADC1->CFGR1 |= 1<<4 | 1<<13;
	ADC1->CHSELR |= ADC_CHSELR_CHSEL10;
	DAC->SWTRIGR |=1;
	DAC->CR|=1;
	/* (1) Ensure that ADEN = 0 */
	/* (2) Clear ADEN by setting ADDIS*/
	/* (3) Clear DMAEN */
	/* (4) Launch the calibration by setting ADCAL */
	/* (5) Wait until ADCAL=0 */
	if ((ADC1->CR & ADC_CR_ADEN) != 0) /* (1) */
	{
	 ADC1->CR |= ADC_CR_ADDIS; /* (2) */
	}
	while ((ADC1->CR & ADC_CR_ADEN) != 0)
	{
	/* For robust implementation, add here time-out management */
	}
	ADC1->CFGR1 &= ~ADC_CFGR1_DMAEN; /* (3) */
	ADC1->CR |= ADC_CR_ADCAL; /* (4) */
	while ((ADC1->CR & ADC_CR_ADCAL) != 0) /* (5) */
	{
	 /* For robust implementation, add here time-out management */
	}
	ADC1->ISR |= ADC_ISR_ADRDY;
	ADC1->CR |= ADC_CR_ADEN;

	while ((ADC1->ISR & ADC_ISR_ADRDY) != 0);
	ADC1->CR |= ADC_CR_ADSTART ;

  /* MCU Configuration--------------------------------------------------------*/

  /* Reset of all peripherals, Initializes the Flash interface and the Systick. */
  HAL_Init();

  /* Configure the system clock */
  SystemClock_Config();

  /* Initialize all configured peripherals */

  /* Infinite loop */
  /* USER CODE BEGIN WHILE */
	int i = 0;
	while(1) //part2
	{
		i++;
		if(i >= 32)
			i = 0;
		HAL_Delay(1);
		DAC->DHR8R1 = sine_table[i];
	}
  while (1) //part1
  {
		while(!(ADC1->ISR >>2 & 1));
    /* USER CODE END WHILE */
		int16_t data = ADC1->DR;
		if(data > 0x0000)
			GPIOC->ODR |= 1<< blue;
		else
			GPIOC->ODR &= ~(1<< blue);
		if(data > 10)
			GPIOC->ODR |= 1<< green;
		else
			GPIOC->ODR &= ~(1<< green);
		if(data > 20)
			GPIOC->ODR |= 1<< orange;
		else
			GPIOC->ODR &= ~(1<< orange);
		if(data >  30)
			GPIOC->ODR |= 1<< red;
		else
			GPIOC->ODR &= ~(1<< red);
  }
}

void SystemClock_Config(void)
{
  RCC_OscInitTypeDef RCC_OscInitStruct = {0};
  RCC_ClkInitTypeDef RCC_ClkInitStruct = {0};

  /** Initializes the RCC Oscillators according to the specified parameters
  * in the RCC_OscInitTypeDef structure.
  */
  RCC_OscInitStruct.OscillatorType = RCC_OSCILLATORTYPE_HSI;
  RCC_OscInitStruct.HSIState = RCC_HSI_ON;
  RCC_OscInitStruct.HSICalibrationValue = RCC_HSICALIBRATION_DEFAULT;
  RCC_OscInitStruct.PLL.PLLState = RCC_PLL_NONE;
  if (HAL_RCC_OscConfig(&RCC_OscInitStruct) != HAL_OK)
  {
    Error_Handler();
  }

  /** Initializes the CPU, AHB and APB buses clocks
  */
  RCC_ClkInitStruct.ClockType = RCC_CLOCKTYPE_HCLK|RCC_CLOCKTYPE_SYSCLK
                              |RCC_CLOCKTYPE_PCLK1;
  RCC_ClkInitStruct.SYSCLKSource = RCC_SYSCLKSOURCE_HSI;
  RCC_ClkInitStruct.AHBCLKDivider = RCC_SYSCLK_DIV1;
  RCC_ClkInitStruct.APB1CLKDivider = RCC_HCLK_DIV1;

  if (HAL_RCC_ClockConfig(&RCC_ClkInitStruct, FLASH_LATENCY_0) != HAL_OK)
  {
    Error_Handler();
  }
}

void Error_Handler(void)
{
  __disable_irq();
  while (1)
  {
  }
}
